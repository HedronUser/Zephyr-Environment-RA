## prj.conf
```kconfig
CONFIG_PRINTK=y
CONFIG_STDOUT_CONSOLE=y

CONFIG_SPI=y

CONFIG_ADC=y
CONFIG_ADC_QMSI_SS=y
CONFIG_ADC_QMSI_POLL=y

CONFIG_SYS_CLOCK_TICKS_PER_SEC=1000

CONFIG_IPM=y
CONFIG_IPM_QUARK_SE=y
CONFIG_IPM_CONSOLE_SENDER=y
CONFIG_CONSOLE=y
CONFIG_SERIAL=n
CONFIG_NANO_TIMEOUTS=y

CONFIG_I2C=y
I2C_QMSI_SS=y
I2C_0=y

CONFIG_GPIO=y
CONFIG_SENSOR=y
CONFIG_DHT=y
CONFIG_DHT_NAME="DHT11"
CONFIG_DHT_CHIP_DHT11=y
CONFIG_DHT_GPIO_DEV_NAME="GPIO_0"
CONFIG_DHT_GPIO_PIN_NUM=19
```

## src/main.c
```c
/* main_arc.c - main source file for ARC app */

/*
 * Copyright (c) 2016 Intel Corporation.
 *
 * Licensed under the Apache License, Version 2.0 (the "License");
 * you may not use this file except in compliance with the License.
 * You may obtain a copy of the License at
 *
 *     http://www.apache.org/licenses/LICENSE-2.0
 *
 * Unless required by applicable law or agreed to in writing, software
 * distributed under the License is distributed on an "AS IS" BASIS,
 * WITHOUT WARRANTIES OR CONDITIONS OF ANY KIND, either express or implied.
 * See the License for the specific language governing permissions and
 * limitations under the License.
 */

#include <zephyr.h>
#include <stdio.h>
#include <device.h>
#include <sensor.h>
#include <adc.h>

#include <ipm.h>
#include <ipm/ipm_quark_se.h>

#include <qm_ss_i2c.h>

#include <init.h>
#include <string.h>

#include <misc/byteorder.h>
#include <misc/printk.h>
#include <misc/util.h>

#include <ipm_ids.h>

#include <MPL3115A2.h>


QUARK_SE_IPM_DEFINE(sensor_ipm, 0, QUARK_SE_IPM_OUTBOUND);

#define ADC_DEVICE_NAME "ADC_0"
#define ADC_CHANNEL 	10
#define ADC_BUFFER_SIZE 4

static uint8_t seq_buffer[ADC_BUFFER_SIZE];

static struct adc_seq_entry sample = {
	.sampling_delay = 12,
	.channel_id = ADC_CHANNEL,
	.buffer = seq_buffer,
	.buffer_length = ADC_BUFFER_SIZE,
};

static struct adc_seq_table table = {
	.entries = &sample,
	.num_entries = 1,
};

void main(void)
{
  struct device *i2c_dev, *dht11_dev, *adc_dev;

  struct device *sensor_ipm;
  int ret;
  float temp, baro, alti, humi, moist;

  // Get the devices
  i2c_dev = device_get_binding("I2C_0");
  if (!i2c_dev)
  {
    printk("Error getting I2C device.\n");
  }

  dht11_dev = device_get_binding("DHT11");
  if (!dht11_dev)
  {
    printf("DHT11: Device not found.\n");
  }

  adc_dev = device_get_binding(ADC_DEVICE_NAME);
  if (!adc_dev)
  {
    printf("Error getting ADC device.\n");
  }

  // Initialize the devices
  mpl3115a2_init(i2c_dev);
  adc_enable(adc_dev);

  // Get the IPM channels
  sensor_ipm = device_get_binding("sensor_ipm");
  if (!sensor_ipm)
  {
    printk("IPM: Device not found.\n");
  }

  while (i2c_dev)
  {
    // Get the values
    temp = mpl3115a2_get_temperature(i2c_dev);
    baro = mpl3115a2_get_pressure(i2c_dev);
    alti = mpl3115a2_get_altitude(i2c_dev);

    if (sensor_sample_fetch(dht11_dev))
    {
      struct sensor_value val;
      if (sensor_channel_get(dht11_dev, SENSOR_CHAN_HUMIDITY, &val) < 0)
      {
	      printf("Humidity channel read error.\n");
      }
      else
      {
	      humi = (float)(val.val1 / 1000.0);
      }
    }

    if (adc_read(adc_dev, &table) == 0) {
      uint32_t m1 = *((uint32_t*)seq_buffer); // This is faster than bit shifting, no math, just dereference.
      
      uint32_t m = m1 & 0xFFF;
      moist = 100.0 - ((m / 4096.0) * 100);
      // printf("SS Moisture: %d - %d  -  %x\n", m, (uint32_t)moist, m1);
    }

    ret = ipm_send(sensor_ipm, 1, IPM_ID_TEMPERATURE, &temp, sizeof(temp));
    if (ret)
    {
      printk("Failed to send IPM_ID_TEMPERATURE message, error (%d)\n", ret);
    }

    k_sleep(100);

    ret = ipm_send(sensor_ipm, 1, IPM_ID_BAROMETER, &baro, sizeof(baro));
    if (ret)
    {
      printk("Failed to send IPM_ID_ALTITUDE message, error (%d)\n", ret);
    }

    k_sleep(100);

    ret = ipm_send(sensor_ipm, 1, IPM_ID_ALTITUDE, &alti, sizeof(alti));
    if (ret)
    {
      printk("Failed to send IPM_ID_ALTITUDE message, error (%d)\n", ret);
    }

    k_sleep(100);

    ret = ipm_send(sensor_ipm, 1, IPM_ID_HUMIDITY, &humi, sizeof(humi));
    if (ret)
    {
      printk("Failed to send IPM_ID_HUMIDITY message, error (%d)\n", ret);
    }

    k_sleep(100);
    ret = ipm_send(sensor_ipm, 1, IPM_ID_MOISTURE, &moist, sizeof(moist));
    if (ret)
    {
      printk("Failed to send IPM_ID_MOISTURE message, error (%d)\n", ret);
    }

    k_sleep(100);
  }
}
```

## include/MPL3115A2.h
```c
#include <zephyr.h>
#include <i2c.h>

/*=========================================================================
    I2C ADDRESS/BITS
    -----------------------------------------------------------------------*/
#define MPL3115A2_ADDRESS (0x60) // 1100000
/*=========================================================================*/

/*=========================================================================
REGISTERS
-----------------------------------------------------------------------*/
#define MPL3115A2_REGISTER_STATUS (0x00)
#define MPL3115A2_REGISTER_STATUS_TDR 0x02
#define MPL3115A2_REGISTER_STATUS_PDR 0x04
#define MPL3115A2_REGISTER_STATUS_PTDR 0x08

#define MPL3115A2_REGISTER_PRESSURE_MSB (0x01)
#define MPL3115A2_REGISTER_PRESSURE_CSB (0x02)
#define MPL3115A2_REGISTER_PRESSURE_LSB (0x03)

#define MPL3115A2_REGISTER_TEMP_MSB (0x04)
#define MPL3115A2_REGISTER_TEMP_LSB (0x05)

#define MPL3115A2_REGISTER_DR_STATUS (0x06)

#define MPL3115A2_OUT_P_DELTA_MSB (0x07)
#define MPL3115A2_OUT_P_DELTA_CSB (0x08)
#define MPL3115A2_OUT_P_DELTA_LSB (0x09)

#define MPL3115A2_OUT_T_DELTA_MSB (0x0A)
#define MPL3115A2_OUT_T_DELTA_LSB (0x0B)

#define MPL3115A2_WHOAMI (0x0C)

#define MPL3115A2_PT_DATA_CFG 0x13
#define MPL3115A2_PT_DATA_CFG_TDEFE 0x01
#define MPL3115A2_PT_DATA_CFG_PDEFE 0x02
#define MPL3115A2_PT_DATA_CFG_DREM 0x04

#define MPL3115A2_CTRL_REG1 (0x26)
#define MPL3115A2_CTRL_REG1_SBYB 0x01
#define MPL3115A2_CTRL_REG1_OST 0x02
#define MPL3115A2_CTRL_REG1_RST 0x04
#define MPL3115A2_CTRL_REG1_OS1 0x00
#define MPL3115A2_CTRL_REG1_OS2 0x08
#define MPL3115A2_CTRL_REG1_OS4 0x10
#define MPL3115A2_CTRL_REG1_OS8 0x18
#define MPL3115A2_CTRL_REG1_OS16 0x20
#define MPL3115A2_CTRL_REG1_OS32 0x28
#define MPL3115A2_CTRL_REG1_OS64 0x30
#define MPL3115A2_CTRL_REG1_OS128 0x38
#define MPL3115A2_CTRL_REG1_RAW 0x40
#define MPL3115A2_CTRL_REG1_ALT 0x80
#define MPL3115A2_CTRL_REG1_BAR 0x00
#define MPL3115A2_CTRL_REG2 (0x27)

#define MPL3115A2_CTRL_REG3 (0x28)
#define MPL3115A2_CTRL_REG4 (0x29)
#define MPL3115A2_CTRL_REG5 (0x2A)

#define MPL3115A2_REGISTER_STARTCONVERSION (0x12)
/*=========================================================================*/

int mpl3115a2_init(struct device *i2c_dev);
float mpl3115a2_get_temperature(struct device *i2c_dev);
float mpl3115a2_get_pressure(struct device *i2c_dev);
float mpl3115a2_get_altitude(struct device *i2c_dev);
```

## src/MPL3115A2.c
```c
// MPL3115A2 Barometric Pressure & Altimeter & Temperature sensor
// Adafruit converted code from the sample library
// Original code lives here: https://github.com/adafruit/Adafruit_MPL3115A2_Library

#include <MPL3115A2.h>

int mpl3115a2_init(struct device *i2c_dev)
{
  uint8_t whoami;
  int ret = i2c_reg_read_byte(i2c_dev, MPL3115A2_ADDRESS, MPL3115A2_WHOAMI, &whoami);
  if (ret)
  {
    printk("Could not read from I2C device %x: %d\n", MPL3115A2_ADDRESS, ret);
  }

  printk("whoami: %x\n", whoami);

  if (whoami != 0xC4)
  {
    return false;
  }

  i2c_reg_write_byte(i2c_dev, MPL3115A2_ADDRESS, MPL3115A2_CTRL_REG1,
                     MPL3115A2_CTRL_REG1_SBYB |
                         MPL3115A2_CTRL_REG1_OS128);

  i2c_reg_write_byte(i2c_dev, MPL3115A2_ADDRESS, MPL3115A2_PT_DATA_CFG,
                     MPL3115A2_PT_DATA_CFG_TDEFE |
                         MPL3115A2_PT_DATA_CFG_PDEFE |
                         MPL3115A2_PT_DATA_CFG_DREM);

  return true;
}

float mpl3115a2_get_temperature(struct device *i2c_dev)
{
  int ret;
  ret = i2c_reg_write_byte(i2c_dev, MPL3115A2_ADDRESS, MPL3115A2_PT_DATA_CFG,
                           MPL3115A2_PT_DATA_CFG_TDEFE |
                               MPL3115A2_PT_DATA_CFG_PDEFE |
                               MPL3115A2_PT_DATA_CFG_DREM);

  if (ret)
  {
    printk("Could not set config on I2C device %x: %d\n", MPL3115A2_ADDRESS, ret);
  }

  uint8_t sta = 0;
  while (!(sta & MPL3115A2_REGISTER_STATUS_TDR))
  {
    ret = i2c_reg_read_byte(i2c_dev, MPL3115A2_ADDRESS, MPL3115A2_REGISTER_STATUS, &sta);
    if (ret)
    {
      sta = 0;
    }
    k_sleep(50);
  }

  uint8_t data[2];
  ret = i2c_burst_read(i2c_dev, MPL3115A2_ADDRESS, MPL3115A2_REGISTER_TEMP_MSB, data, sizeof(data));
  if (ret)
  {
    printk("Could not read from I2C device %x: %d\n", MPL3115A2_ADDRESS, ret);
  }

  int16_t t;
  t = data[0];
  t <<= 8;
  t |= data[1];
  t >>= 4;

  float temp = t;
  temp /= 16.0;

  i2c_reg_write_byte(i2c_dev, MPL3115A2_ADDRESS, MPL3115A2_REGISTER_TEMP_MSB, 0);

  return temp;
}

float mpl3115a2_get_pressure(struct device *i2c_dev)
{
  int ret;

  ret = i2c_reg_write_byte(i2c_dev, MPL3115A2_ADDRESS, MPL3115A2_CTRL_REG1,
                           MPL3115A2_CTRL_REG1_OS128 |
                               MPL3115A2_CTRL_REG1_OST |
                               MPL3115A2_CTRL_REG1_BAR);

  if (ret)
  {
    printk("Could not set control register on I2C device %x: %d\n", MPL3115A2_ADDRESS, ret);
  }

  uint8_t sta = 0;
  while (!(sta & MPL3115A2_REGISTER_STATUS_PDR))
  {
    ret = i2c_reg_read_byte(i2c_dev, MPL3115A2_ADDRESS, MPL3115A2_REGISTER_STATUS, &sta);
    if (ret)
    {
      sta = 0;
    }
    k_sleep(50);
  }

  uint8_t data[3];
  ret = i2c_burst_read(i2c_dev, MPL3115A2_ADDRESS, MPL3115A2_REGISTER_PRESSURE_MSB, data, sizeof(data));
  if (ret)
  {
    printk("Could not read from I2C device %x: %d\n", MPL3115A2_ADDRESS, ret);
  }

  int32_t p;
  p = data[0];
  p <<= 8;
  p |= data[1];
  p <<= 8;
  p |= data[2];
  p >>= 4;

  float baro = p;
  baro /= 4.0;

  i2c_reg_write_byte(i2c_dev, MPL3115A2_ADDRESS, MPL3115A2_REGISTER_PRESSURE_MSB, 0);

  return baro;
}

float mpl3115a2_get_altitude(struct device *i2c_dev)
{
  int ret;

  ret = i2c_reg_write_byte(i2c_dev, MPL3115A2_ADDRESS, MPL3115A2_CTRL_REG1,
                           MPL3115A2_CTRL_REG1_OS128 |
                               MPL3115A2_CTRL_REG1_OST |
                               MPL3115A2_CTRL_REG1_ALT);

  if (ret)
  {
    printk("Could not set control register on I2C device %x: %d\n", MPL3115A2_ADDRESS, ret);
  }

  uint8_t sta = 0;
  while (!(sta & MPL3115A2_REGISTER_STATUS_PDR))
  {
    ret = i2c_reg_read_byte(i2c_dev, MPL3115A2_ADDRESS, MPL3115A2_REGISTER_STATUS, &sta);
    if (ret)
    {
      sta = 0;
    }
    k_sleep(50);
  }

  uint8_t data[3];
  ret = i2c_burst_read(i2c_dev, MPL3115A2_ADDRESS, MPL3115A2_REGISTER_PRESSURE_MSB, &data, sizeof(data));
  if (ret)
  {
    printk("Could not read from I2C device %x: %d\n", MPL3115A2_ADDRESS, ret);
  }

  int32_t a;
  a = data[0];
  a <<= 8;
  a |= data[1];
  a <<= 8;
  a |= data[2];
  a >>= 4;

  if (a & 0x80000)
  {
    a |= 0xFFF00000;
  }

  float alti = a;
  alti /= 16.0;

  i2c_reg_write_byte(i2c_dev, MPL3115A2_ADDRESS, MPL3115A2_REGISTER_PRESSURE_MSB, 0);

  return alti;
}
```
